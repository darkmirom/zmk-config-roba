## config/west.yml
```yaml
manifest:
  remotes:
    - name: zmkfirmware
      url-base: https://github.com/zmkfirmware
    - name: badjeff
      url-base: https://github.com/badjeff

  projects:
    - name: zmk
      remote: zmkfirmware
      revision: v0.2       # ← main ではなく安定版に固定
      import: app/west.yml

    # PMW3610 ドライバ（パス指定は不要。モジュールとして自動認識されます）
    - name: zmk-pmw3610-driver
      remote: badjeff
      revision: main

  self:
    path: config           # ← ここを '.' から 'config' に
```
